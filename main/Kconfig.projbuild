## main/Kconfig.projbuild
```kconfig
menu "Example Configuration"
    menuconfig EXAMPLE_AGENTS_ENABLE_COZE
        bool "Enable Coze agent"
        select BROOKESIA_AGENT_COZE_ENABLE_AUTO_REGISTER
        default n

    if EXAMPLE_AGENTS_ENABLE_COZE
        config EXAMPLE_AGENTS_COZE_APP_ID
            string "App ID"
            default "110049xxxxxxx"

        config EXAMPLE_AGENTS_COZE_PUBLIC_KEY
            string "Public key"
            default "lsKjtB67xxxxxxxxxxxxxxxxxxxxxxxxxxxxxxxxxxx"

        config EXAMPLE_AGENTS_COZE_PRIVATE_KEY_FILE_PATH
            string "Private key"
            default "./private_key.pem"

        config EXAMPLE_AGENTS_COZE_CUSTOM_CONSUMER
            string "Custom consumer (Optional)"
            default ""

        menuconfig EXAMPLE_AGENTS_COZE_BOT1_ENABLE
            bool "Bot 1"
            default y

        if EXAMPLE_AGENTS_COZE_BOT1_ENABLE
            config EXAMPLE_AGENTS_COZE_BOT1_NAME
                string "Bot name"
                default "Lin Jia Nv Hai"

            config EXAMPLE_AGENTS_COZE_BOT1_ID
                string "Bot ID"
                default "7516538xxxxxxxxxxxx"

            config EXAMPLE_AGENTS_COZE_BOT1_DESCRIPTION
                string "Bot description"
                default "A warm-voiced female AI character who listens to the user's thoughts and offers comforting responses."

            config EXAMPLE_AGENTS_COZE_BOT1_VOICE_ID
                string "Bot voice ID"
                default "7426720361733144585"
        endif

        menuconfig EXAMPLE_AGENTS_COZE_BOT2_ENABLE
            bool "Bot 2"
            default n

        if EXAMPLE_AGENTS_COZE_BOT2_ENABLE
            config EXAMPLE_AGENTS_COZE_BOT2_NAME
                string "Bot name"
                default "Wan Qu Da Shu"

            config EXAMPLE_AGENTS_COZE_BOT2_ID
                string "Bot ID"
                default "7516538xxxxxxxxxxxx"

            config EXAMPLE_AGENTS_COZE_BOT2_DESCRIPTION
                string "Bot description"
                default "A male AI character with a regional accent. He responds quickly and concisely, but does not perform actions on behalf of the user."

            config EXAMPLE_AGENTS_COZE_BOT2_VOICE_ID
                string "Bot voice ID"
                default "7426720361732915209"
        endif
    endif

    menuconfig EXAMPLE_AGENTS_ENABLE_OPENAI
        bool "Enable OpenAI agent"
        select BROOKESIA_AGENT_OPENAI_ENABLE_AUTO_REGISTER
        default n

    if EXAMPLE_AGENTS_ENABLE_OPENAI
        config EXAMPLE_AGENTS_OPENAI_API_KEY
            string "API key"
            default "sk-proj-xxx"

        config EXAMPLE_AGENTS_OPENAI_MODEL
            string "Model"
            default "gpt-realtime-2"

        config EXAMPLE_AGENTS_OPENAI_VOICE
            string "Voice"
            default "alloy"
    endif

    menuconfig EXAMPLE_AGENTS_ENABLE_XIAOZHI
        bool "Enable Xiaozhi agent"
        select BROOKESIA_AGENT_XIAOZHI_ENABLE_AUTO_REGISTER
        default y

    config EXAMPLE_UI_AUTO_HOME_TIMEOUT_MS
        int "UI auto-Home timeout (ms)"
        range 1000 3600000
        default 30000
        help
            Time without physical LCD input before navigation screens may
            return to Home. Clock and critical flows are not redirected.

    config EXAMPLE_IMU_LIFT_TILT_DEGREES
        int "Lift-to-wake tilt threshold (degrees)"
        range 10 60
        default 25

    config EXAMPLE_IMU_LIFT_STABLE_MS
        int "Lift-to-wake stable pose duration (ms)"
        range 100 1000
        default 200

    config EXAMPLE_IMU_LIFT_COOLDOWN_MS
        int "Lift-to-wake cooldown (ms)"
        range 1000 10000
        default 3000

    config EXAMPLE_PWR_DIM_TIMEOUT_MS
        int "Power dim timeout (ms)"
        range 1000 3600000
        default 60000
        help
            Time without physical LCD input before the power manager may dim
            the display. If the agent is active, dimming waits until it sleeps.

    config EXAMPLE_PWR_DIM_BRIGHTNESS_PERCENT
        int "Power dim brightness (percent)"
        range 1 100
        default 10

    config EXAMPLE_PWR_HW_SLEEP_TIMEOUT_MS
        int "Hardware sleep timeout after dimming (ms)"
        range 1000 86400000
        default 300000
        help
            Time measured from successful entry into the Dimmed state.
            Registered display participants coordinate render pause and panel sleep.

    config EXAMPLE_PWR_PREPARE_TIMEOUT_MS
        int "Suspend prepare and commit acknowledgement timeout (ms)"
        range 100 60000
        default 2000
        help
            Deadline for each prepare or commit stage of registered participants.
            Does not replace panel-specific command timing.

    config EXAMPLE_PWR_RESUME_TIMEOUT_MS
        int "Suspend cancellation and resume timeout (ms)"
        range 100 60000
        default 2000

    config EXAMPLE_PWR_SUSPEND_RETRY_MS
        int "Suspend retry backoff (ms)"
        range 100 60000
        default 5000

    config EXAMPLE_PWR_MEMORY_DIAGNOSTICS
        bool "Log Pwr heap and worker-stack diagnostics"
        default n
        help
            Print SRAM/PSRAM and worker stack measurements at power state changes,
            plus heap measurements around Pwr service startup. The shared memory
            profiler and power warning/error logs remain enabled independently.

    config EXAMPLE_SYSTEM_STATS
        bool "Log periodic SYSTEM STATS block"
        depends on FREERTOS_USE_TRACE_FACILITY && FREERTOS_GENERATE_RUN_TIME_STATS
        default n
        help
            Print one SYSTEM STATS block every 10 seconds: per-core busy time,
            per-task CPU, stack high-water marks and SRAM/PSRAM/DMA heap figures.
            It replaces the thread and memory profiler tables. The UI memory bars
            keep using the memory profiler. Diagnostic only; leave off for
            production images.

endmenu

menu "Memory Diagnostics"

    config EXAMPLE_MEMORY_DIAGNOSTICS
        bool "Log internal RAM, PSRAM, task stack and CPU statistics"
        default n
        help
            Logs MEMDIAG lines for internal and PSRAM heap, per-task stack high-water
            marks and CPU usage at fixed checkpoints and periodically. A low-priority
            worker with a PSRAM stack does all measuring and logging; callers only
            enqueue a small request. Intended for measurement builds only.

    config EXAMPLE_MEMORY_DIAGNOSTICS_PERIOD_MS
        int "Periodic full snapshot interval (ms), 0 disables"
        depends on EXAMPLE_MEMORY_DIAGNOSTICS
        range 0 600000
        default 15000

    config EXAMPLE_MEMORY_DIAGNOSTICS_TASKS
        bool "Include per-task stack high-water marks"
        depends on EXAMPLE_MEMORY_DIAGNOSTICS
        select FREERTOS_USE_TRACE_FACILITY
        select FREERTOS_VTASKLIST_INCLUDE_COREID
        default y
        help
            Adds one line per task with affinity, priority, stack region and stack
            high-water mark in bytes to every full snapshot.

    config EXAMPLE_MEMORY_DIAGNOSTICS_CPU
        bool "Include per-task and per-core CPU usage"
        depends on EXAMPLE_MEMORY_DIAGNOSTICS && EXAMPLE_MEMORY_DIAGNOSTICS_TASKS
        select FREERTOS_GENERATE_RUN_TIME_STATS
        default y
        help
            Reports CPU usage as the delta between two consecutive full snapshots,
            using the FreeRTOS run time counter that ESP-IDF already drives from the
            ESP timer. Per-core busy time is derived from the IDLE0/IDLE1 tasks.

endmenu
```

## sdkconfig.defaults
```kconfig
CONFIG_FREERTOS_HZ=1000
CONFIG_ESP_MAIN_TASK_STACK_SIZE=4096
CONFIG_ESP_INT_WDT_TIMEOUT_MS=2000
CONFIG_ESP_TASK_WDT_TIMEOUT_S=10
CONFIG_COMPILER_OPTIMIZATION_PERF=y

CONFIG_ESP_TLS_USE_DS_PERIPHERAL=n
# Fail closed when a TLS client does not provide a CA certificate, certificate
# bundle, or another explicit verification source.
# CONFIG_ESP_TLS_INSECURE is not set
CONFIG_MBEDTLS_CERTIFICATE_BUNDLE=y
# Avoid `esp-x509-crt-bundle` error
CONFIG_MBEDTLS_CERTIFICATE_BUNDLE_DEFAULT_FULL=y
CONFIG_MBEDTLS_CERTIFICATE_BUNDLE_DEFAULT_CMN=n
CONFIG_MBEDTLS_CERTIFICATE_BUNDLE_CROSS_SIGNED_VERIFY=y

CONFIG_LWIP_FALLBACK_DNS_SERVER_SUPPORT=y
CONFIG_LWIP_DNS_SETSERVER_WITH_NETIF=y
CONFIG_MBEDTLS_EXTERNAL_MEM_ALLOC=y
CONFIG_MBEDTLS_DYNAMIC_BUFFER=y
CONFIG_MBEDTLS_SSL_KEEP_PEER_CERTIFICATE=n
# MQTT input/output buffers do not require DMA-capable internal RAM.
CONFIG_MQTT_BUFFERS_ON_EXTERNAL_MEMORY=y

# LVGL
CONFIG_LV_USE_CLIB_MALLOC=y
CONFIG_LV_USE_CLIB_STRING=y
CONFIG_LV_USE_CLIB_SPRINTF=y
CONFIG_LV_DEF_REFR_PERIOD=10
CONFIG_LV_DPI_DEF=60
CONFIG_LV_DRAW_LAYER_SIMPLE_BUF_SIZE=48000
CONFIG_LV_DRAW_SW_SHADOW_CACHE_SIZE=4
CONFIG_LV_GRADIENT_MAX_STOPS=4
CONFIG_LV_OBJ_STYLE_CACHE=y
CONFIG_LV_USE_SYSMON=y
CONFIG_LV_FONT_MONTSERRAT_30=y
CONFIG_LV_FONT_MONTSERRAT_14=y
CONFIG_LV_FONT_MONTSERRAT_24=y
CONFIG_LV_FONT_MONTSERRAT_32=y
CONFIG_LV_TXT_ENC_UTF8=y
CONFIG_LV_DRAW_THREAD_PRIO=4
CONFIG_LV_CACHE_DEF_SIZE=1024000
CONFIG_LV_IMAGE_HEADER_CACHE_DEF_CNT=32
CONFIG_LV_USE_LOG=y
CONFIG_LV_LOG_PRINTF=y
CONFIG_LV_FS_STDIO_LETTER=65
CONFIG_LV_FS_POSIX_LETTER=65
CONFIG_LV_FS_DEFAULT_DRIVER_LETTER=65
CONFIG_LV_USE_LODEPNG=y
CONFIG_LV_USE_BUTTONMATRIX=y
CONFIG_LV_USE_KEYBOARD=y
CONFIG_LV_USE_TEXTAREA=y
CONFIG_LV_USE_QRCODE=y
CONFIG_ESP_LVGL_ADAPTER_ENABLE_DECODER=y

# Developer Mode USB mass storage (same configuration as esp_speaker).
CONFIG_TINYUSB_DESC_USE_DEFAULT_PID=n
CONFIG_TINYUSB_DESC_CUSTOM_PID=0x4001
CONFIG_TINYUSB_MSC_ENABLED=y
CONFIG_TINYUSB_MSC_BUFSIZE=4096
CONFIG_FATFS_USE_LABEL=y

# VoCat v1.0 has no camera; keep the AV processor's optional video stack out.
CONFIG_VIDEO_PROCESSOR_ENABLE=n

# Brookesia:Hal
CONFIG_BROOKESIA_HAL_ADAPTOR_DISPLAY_LCD_PANEL_INIT_THREAD_CORE_ID=1

# Keep the LCD dark until LVGL and the Emote renderer are ready. The app
# restores the persisted brightness/on state after the display pipeline starts.
CONFIG_BROOKESIA_SERVICE_DISPLAY_BACKLIGHT_ENABLE_AUTO_LOAD_DATA=n

# Brookesia:Utils
CONFIG_BROOKESIA_UTILS_THREAD_PROFILER_ENABLE_FREERTOS_CONFIG=y
# Save SRAM
CONFIG_BROOKESIA_UTILS_LOG_ENABLE_FILE_AND_LINE=n
CONFIG_BROOKESIA_UTILS_LOG_ENABLE_FUNCTION_NAME=n

# Vietnam local time for the SNTP service (POSIX TZ: UTC+7).
CONFIG_BROOKESIA_SERVICE_SNTP_DEFAULT_TIMEZONE="ICT-7"

# Brookesia:Agent
CONFIG_BROOKESIA_AGENT_MANAGER_DEFAULT_CHAT_MODE_HALF_DUPLEX=y
# Coze
CONFIG_BROOKESIA_AGENT_COZE_ENABLE_AUTO_REGISTER=n
CONFIG_MBEDTLS_DYNAMIC_BUFFER=n
# Openai
CONFIG_WS_BUFFER_SIZE=2048
CONFIG_BROOKESIA_AGENT_OPENAI_ENABLE_AUTO_REGISTER=n
# XiaoZhi
CONFIG_XIAOZHI_AUDIO_TASK_ALLOC_DYNAMIC=y
CONFIG_XIAOZHI_STACK_IN_PSRAM=y
CONFIG_XIAOZHI_SYNC_SYSTEM_TIME_FROM_SERVER=n
CONFIG_BROOKESIA_AGENT_XIAOZHI_ENABLE_AUTO_REGISTER=n

# Brookesia:Expression:Emote
CONFIG_EXAMPLE_EXPRESSIONS_ENABLE_EMOTE=y
CONFIG_MMAP_FILE_NAME_LENGTH=32

# H264 (Save RAM and Flash)
CONFIG_ESP_H264_DECODER_IRAM=n
CONFIG_VIDEO_DECODER_SW_H264_SUPPORT=n
CONFIG_VIDEO_ENCODER_SW_H264_SUPPORT=n

# Audio Codec
CONFIG_AUDIO_DECODER_AAC_SUPPORT=n
CONFIG_AUDIO_DECODER_MP3_SUPPORT=y
CONFIG_AUDIO_DECODER_G711_SUPPORT=y
CONFIG_AUDIO_DECODER_AMRNB_SUPPORT=n
CONFIG_AUDIO_DECODER_AMRWB_SUPPORT=n
CONFIG_AUDIO_DECODER_FLAC_SUPPORT=n
CONFIG_AUDIO_DECODER_OPUS_SUPPORT=y
CONFIG_AUDIO_DECODER_VORBIS_SUPPORT=n
CONFIG_AUDIO_DECODER_ADPCM_SUPPORT=n
CONFIG_AUDIO_DECODER_ALAC_SUPPORT=n
CONFIG_AUDIO_DECODER_PCM_SUPPORT=y
CONFIG_AUDIO_DECODER_SBC_SUPPORT=n
CONFIG_AUDIO_DECODER_LC3_SUPPORT=n
CONFIG_AUDIO_DECODER_G722_SUPPORT=n
CONFIG_AUDIO_SIMPLE_DEC_WAV_SUPPORT=n
CONFIG_AUDIO_SIMPLE_DEC_M4A_SUPPORT=n
CONFIG_AUDIO_SIMPLE_DEC_TS_SUPPORT=n
CONFIG_AUDIO_SIMPLE_DEC_OGG_SUPPORT=n
CONFIG_AUDIO_ENCODER_AAC_SUPPORT=n
CONFIG_AUDIO_ENCODER_G711_SUPPORT=y
CONFIG_AUDIO_ENCODER_AMRNB_SUPPORT=n
CONFIG_AUDIO_ENCODER_AMRWB_SUPPORT=n
CONFIG_AUDIO_ENCODER_OPUS_SUPPORT=y
CONFIG_AUDIO_ENCODER_ADPCM_SUPPORT=n
CONFIG_AUDIO_ENCODER_ALAC_SUPPORT=n
CONFIG_AUDIO_ENCODER_PCM_SUPPORT=y
CONFIG_AUDIO_ENCODER_SBC_SUPPORT=n
CONFIG_AUDIO_ENCODER_LC3_SUPPORT=n
CONFIG_AUDIO_ENCODER_G722_SUPPORT=n
```
